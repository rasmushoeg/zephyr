## CMakeLists.txt
```
# SPDX-License-Identifier: Apache-2.0

cmake_minimum_required(VERSION 3.20.0)
find_package(Zephyr REQUIRED HINTS $ENV{ZEPHYR_BASE})
project(hap_ha)

target_sources(app PRIVATE
  src/bap_unicast_sr.c
  src/has_server.c
  src/main.c
  src/vcp_vol_renderer.c
  src/stream_rx.c
)

target_sources_ifdef(CONFIG_HAP_HA_HEARING_AID_BINAURAL app PRIVATE
  src/csip_set_member.c
)

target_sources_ifdef(CONFIG_BT_ASCS_ASE_SRC app PRIVATE
  src/micp_mic_dev.c
)

target_sources_ifdef(CONFIG_BT_TBS_CLIENT app PRIVATE
  src/ccp_call_ctrl.c
)
target_sources_ifdef(CONFIG_ENABLE_LC3 app PRIVATE src/lc3.c)

if (CONFIG_USE_USB_AUDIO_OUTPUT)
  include(${ZEPHYR_BASE}/samples/subsys/usb/common/common.cmake)
  target_sources(app PRIVATE src/usb.c)
endif()

zephyr_library_include_directories(${ZEPHYR_BASE}/samples/bluetooth)
```

## Kconfig
```
#
# Copyright (c) 2022 Codecoup
#
# SPDX-License-Identifier: Apache-2.0
#

mainmenu "Bluetooth: Hearing Aid"

menu "Zephyr"
source "Kconfig.zephyr"
endmenu

menu "Hearing Aid"

config HAP_HA_SET_RANK
	int "Device rank in set"
	depends on BT_CSIP_SET_MEMBER
	range 1 2
	help
	  Rank of this device in set.

choice HAP_HA_HEARING_AID_TYPE_CHOICE
	prompt "Hearing Aid Type selection"
	help
	  Select the Hearing Aid Type to compile.

config HAP_HA_HEARING_AID_MONAURAL
	bool "Monaural Hearing Aid"

config HAP_HA_HEARING_AID_BINAURAL
	depends on BT_CSIP_SET_MEMBER
	bool "Binaural Hearing Aid"

config HAP_HA_HEARING_AID_BANDED
	bool "Banded Hearing Aid"

endchoice # HAP_HA_HEARING_AID_TYPE_CHOICE

choice HAP_HA_HEARING_AID_LOCATION
	prompt "Hearing Aid Device Location"
	help
	  Select the Hearing Aid Device location.

config HAP_HA_HEARING_AID_LEFT
	bool "Left Ear"

config HAP_HA_HEARING_AID_RIGHT
	bool "Right Ear"

endchoice # HAP_HA_HEARING_AID_LOCATION

config MAX_CODEC_FRAMES_PER_SDU
	int "The maximum number of codec frame per SDU supported"
	default 1
	range 1 255
	help
	  Maximum number of codec frames per SDU supported by this device. Increasing this value
	  allows support for a greater variety of broadcasts, but also increases memory usage.

config ENABLE_LC3
	bool "Enable the LC3 codec"
	# By default let's enable it in the platforms we know are capable of supporting it
	default y
	depends on CPU_HAS_FPU && \
	 (ARCH_POSIX || SOC_COMPATIBLE_NRF52X || SOC_COMPATIBLE_NRF5340_CPUAPP || SOC_MIMXRT1062)
	select LIBLC3
	select FPU

config USE_SPECIFIC_BROADCAST_CHANNEL
	bool "Use specific Broadcast Channel Audio Location"
	default y
	#depends on USE_USB_AUDIO_OUTPUT
	help
	  Enables the use of a specific Channel Audio Location (see config TARGET_BROADCAST_CHANNEL).


config TARGET_BROADCAST_CHANNEL
	int "Broadcast Channel Audio Location to sync to"
	range 0 3
	default 1
	help
	  Channel Audio Location to sync to. These corresponds to the bt_audio_location,
	  supporting mono, left and right channels

config INFO_REPORTING_INTERVAL
	int "Number of SDUs received between each information report"
	default 500
	help
	  Determines how often information about received data is logged.
	  Set to 0 to disable reporting.

endmenu
```

## prj.conf
```kconfig
CONFIG_BT=y
CONFIG_ASSERT=y
CONFIG_BT_PERIPHERAL=y
CONFIG_BT_GAP_AUTO_UPDATE_CONN_PARAMS=n
# Set preferred values based on BT_BAP_CONN_PARAM_RELAXED
CONFIG_BT_PERIPHERAL_PREF_MIN_INT=50
CONFIG_BT_PERIPHERAL_PREF_MAX_INT=70
CONFIG_BT_PERIPHERAL_PREF_LATENCY=0
CONFIG_BT_PERIPHERAL_PREF_TIMEOUT=400
CONFIG_BT_ISO_PERIPHERAL=y
CONFIG_BT_PRIVACY=y
CONFIG_BT_GATT_DYNAMIC_DB=y
CONFIG_BT_GATT_CLIENT=y
CONFIG_BT_GATT_AUTO_DISCOVER_CCC=y

CONFIG_BT_SMP=y
CONFIG_BT_SMP_SC_PAIR_ONLY=y
CONFIG_BT_SMP_MIN_ENC_KEY_SIZE=16

CONFIG_BT_EXT_ADV=y
CONFIG_BT_DEVICE_NAME="Hearing Aid sample"
# Appearance: Generic Hearing aid (0x0A40)
CONFIG_BT_DEVICE_APPEARANCE=2624

# Mandatory to support at least 1 for ASCS
CONFIG_BT_ATT_PREPARE_COUNT=1

CONFIG_BT_AUDIO=y
CONFIG_BT_BAP_UNICAST_SERVER=y
CONFIG_BT_ASCS=y
CONFIG_BT_PAC_SNK=y
CONFIG_BT_ASCS_MAX_ASE_SNK_COUNT=1
CONFIG_BT_PAC_SRC=y
CONFIG_BT_ASCS_MAX_ASE_SRC_COUNT=1
# Support an ISO channel per ASE
CONFIG_BT_ISO_MAX_CHAN=2

CONFIG_BT_PAC_SNK_LOC=y
CONFIG_BT_PAC_SRC_LOC=y

CONFIG_BT_VCP_VOL_REND=y
CONFIG_BT_MICP_MIC_DEV=y
CONFIG_UTF8=y
CONFIG_BT_HAS=y
CONFIG_HAP_HA_HEARING_AID_MONAURAL=y
CONFIG_BT_HAS_PRESET_COUNT=4
CONFIG_BT_HAS_PRESET_NAME_DYNAMIC=y
CONFIG_BT_CAP_ACCEPTOR=y

CONFIG_BT_AICS_MAX_INSTANCE_COUNT=2
# The HA may expose an instance of MICS and an instance of AICS to control
# the capture of ambient sound.
CONFIG_BT_VCP_VOL_REND_AICS_INSTANCE_COUNT=1
# An HA may instantiate one or more instances of Audio Input Control Service
# (AICS) to expose control of the gain of its inputs to a Volume Controller.
CONFIG_BT_MICP_MIC_DEV_AICS_INSTANCE_COUNT=1

# If the HA supports the Volume Balance feature (see Section 3.1) and the HA
# is part of a Binaural Hearing Aid Set, the HA shall instantiate one instance
# of Volume Offset Control Service (VOCS).
CONFIG_BT_VOCS_MAX_INSTANCE_COUNT=1
CONFIG_BT_VCP_VOL_REND_VOCS_INSTANCE_COUNT=1

CONFIG_BT_BAS=y
CONFIG_BT_IAS=y

CONFIG_BT_TBS_CLIENT_MINIMAL=y
CONFIG_BT_TBS_CLIENT_GTBS=y
CONFIG_BT_TBS_CLIENT_CCID=y
CONFIG_BT_TBS_CLIENT_STATUS_FLAGS=y

CONFIG_BT_BAS_BLS=y
CONFIG_BT_BAS_BLS_IDENTIFIER_PRESENT=y
CONFIG_BT_BAS_BLS_BATTERY_LEVEL_PRESENT=y
CONFIG_BT_BAS_BLS_ADDITIONAL_STATUS_PRESENT=y

CONFIG_LOG=y
CONFIG_BT_BUF_ACL_RX_SIZE=255
CONFIG_BT_BUF_ACL_TX_SIZE=251

# Increased for interoperability; some phones send more metadata than default allows.
CONFIG_BT_AUDIO_CODEC_CFG_MAX_METADATA_SIZE=10
```

## src/main.c
```c
/*
 * Copyright (c) 2022 Codecoup
 * Copyright (c) 2026 Demant A/S
 *
 * SPDX-License-Identifier: Apache-2.0
 */
#include <stddef.h>
#include <stdint.h>

#include <zephyr/bluetooth/audio/audio.h>
#include <zephyr/bluetooth/audio/bap.h>
#include <zephyr/bluetooth/audio/csip.h>
#include <zephyr/bluetooth/audio/pacs.h>
#include <zephyr/bluetooth/bluetooth.h>
#include <zephyr/bluetooth/byteorder.h>
#include <zephyr/bluetooth/conn.h>
#include <zephyr/bluetooth/gap.h>
#include <zephyr/bluetooth/iso.h>
#include <zephyr/bluetooth/services/ias.h>
#include <zephyr/bluetooth/uuid.h>
#include <zephyr/kernel.h>
#include <zephyr/sys/__assert.h>
#include <zephyr/sys/byteorder.h>
#include <zephyr/sys/printk.h>
#include <zephyr/sys/util.h>
#include <zephyr/sys/util_macro.h>

#include "hap_ha.h"

static uint8_t unicast_server_addata[] = {
	BT_UUID_16_ENCODE(BT_UUID_ASCS_VAL),	/* ASCS UUID */
	BT_AUDIO_UNICAST_ANNOUNCEMENT_TARGETED, /* Target Announcement */
	BT_BYTES_LIST_LE16(HAP_CONTEXT),
	BT_BYTES_LIST_LE16(HAP_CONTEXT),
	0x00, /* Metadata length */
};

static uint8_t csis_rsi_addata[BT_CSIP_RSI_SIZE];

/* TODO: Expand with BAP data */
static const struct bt_data ad[] = {
	BT_DATA_BYTES(BT_DATA_FLAGS, (BT_LE_AD_GENERAL | BT_LE_AD_NO_BREDR)),
	BT_DATA_BYTES(BT_DATA_UUID16_ALL, BT_UUID_16_ENCODE(BT_UUID_BASS_VAL),
		      BT_UUID_16_ENCODE(BT_UUID_ASCS_VAL)),
#if defined(CONFIG_BT_CSIP_SET_MEMBER)
	BT_DATA(BT_DATA_CSIS_RSI, csis_rsi_addata, ARRAY_SIZE(csis_rsi_addata)),
#endif /* CONFIG_BT_CSIP_SET_MEMBER */
	BT_DATA(BT_DATA_SVC_DATA16, unicast_server_addata, ARRAY_SIZE(unicast_server_addata)),
	BT_DATA(BT_DATA_NAME_COMPLETE, CONFIG_BT_DEVICE_NAME, sizeof(CONFIG_BT_DEVICE_NAME) - 1),
};

static struct k_work_delayable adv_work;
static struct bt_le_ext_adv *ext_adv;

static void disconnected(struct bt_conn *conn, uint8_t reason)
{
	/* Restart advertising after disconnection */
	k_work_schedule(&adv_work, K_SECONDS(1));
}

BT_CONN_CB_DEFINE(conn_callbacks) = {
	.disconnected = disconnected,
};

#if defined(CONFIG_BT_PRIVACY) && defined(CONFIG_BT_CSIP_SET_MEMBER)
static bool adv_rpa_expired_cb(struct bt_le_ext_adv *adv)
{
	char rsi_str[13];
	int err;

	err = csip_generate_rsi(csis_rsi_addata);
	if (err != 0) {
		printk("Failed to generate RSI (err %d)\n", err);
		return false;
	}

	snprintk(rsi_str, ARRAY_SIZE(rsi_str), "%02x%02x%02x%02x%02x%02x", csis_rsi_addata[0],
		 csis_rsi_addata[1], csis_rsi_addata[2], csis_rsi_addata[3], csis_rsi_addata[4],
		 csis_rsi_addata[5]);

	printk("PRSI: 0x%s\n", rsi_str);

	err = bt_le_ext_adv_set_data(adv, ad, ARRAY_SIZE(ad), NULL, 0);
	if (err) {
		printk("Failed to set advertising data (err %d)\n", err);
		return false;
	}

	return true;
}
#endif /* CONFIG_BT_PRIVACY && CONFIG_BT_CSIP_SET_MEMBER */

static const struct bt_le_ext_adv_cb adv_cb = {
#if defined(CONFIG_BT_PRIVACY) && defined(CONFIG_BT_CSIP_SET_MEMBER)
	.rpa_expired = adv_rpa_expired_cb,
#endif /* CONFIG_BT_PRIVACY && CONFIG_BT_CSIP_SET_MEMBER */
};

static void adv_work_handler(struct k_work *work)
{
	int err;

	if (ext_adv == NULL) {
		/* Create a connectable advertising set */
		err = bt_le_ext_adv_create(BT_BAP_ADV_PARAM_CONN_QUICK, &adv_cb, &ext_adv);
		if (err) {
			printk("Failed to create advertising set (err %d)\n", err);
		}

		err = bt_le_ext_adv_set_data(ext_adv, ad, ARRAY_SIZE(ad), NULL, 0);
		if (err) {
			printk("Failed to set advertising data (err %d)\n", err);
		}

		__ASSERT_NO_MSG(err == 0);
	}

	err = bt_le_ext_adv_start(ext_adv, BT_LE_EXT_ADV_START_DEFAULT);
	if (err) {
		printk("Failed to start advertising set (err %d)\n", err);
	} else {
		printk("Advertising successfully started\n");
	}
}

#if defined(CONFIG_BT_IAS)
static void alert_stop(void) { printk("Alert stopped\n"); }

static void alert_start(void) { printk("Mild alert started\n"); }

static void alert_high_start(void) { printk("High alert started\n"); }

BT_IAS_CB_DEFINE(ias_callbacks) = {
	.no_alert = alert_stop,
	.mild_alert = alert_start,
	.high_alert = alert_high_start,
};
#endif /* CONFIG_BT_IAS */

int main(void)
{
	int err;

	err = bt_enable(NULL);
	if (err != 0) {
		printk("Bluetooth init failed (err %d)\n", err);
		return 0;
	}

	printk("Bluetooth initialized\n");

	err = has_server_init();
	if (err != 0) {
		printk("HAS Server init failed (err %d)\n", err);
		return 0;
	}

	err = bap_unicast_sr_init();
	if (err != 0) {
		printk("BAP Unicast Server init failed (err %d)\n", err);
		return 0;
	}

	err = bap_broadcast_snk_init();
	if (err != 0) {
		printk("BAP broadcast sink init failed (err %d)\n", err);
	}

	if (IS_ENABLED(CONFIG_HAP_HA_HEARING_AID_BINAURAL)) {
		err = csip_set_member_init();
		if (err != 0) {
			printk("CSIP Set Member init failed (err %d)\n", err);
			return 0;
		}

		err = csip_generate_rsi(csis_rsi_addata);
		if (err != 0) {
			printk("Failed to generate RSI (err %d)\n", err);
			return 0;
		}
	}

	err = vcp_vol_renderer_init();
	if (err != 0) {
		printk("VCP Volume Renderer init failed (err %d)\n", err);
		return 0;
	}

	if (IS_ENABLED(CONFIG_BT_ASCS_ASE_SRC)) {
		err = micp_mic_dev_init();
		if (err != 0) {
			printk("MICP Microphone Device init failed (err %d)\n", err);
			return 0;
		}
	}

	if (IS_ENABLED(CONFIG_BT_TBS_CLIENT)) {
		err = ccp_call_ctrl_init();
		if (err != 0) {
			printk("MICP Microphone Device init failed (err %d)\n", err);
			return 0;
		}
	}

	k_work_init_delayable(&adv_work, adv_work_handler);
	k_work_schedule(&adv_work, K_NO_WAIT);

	bap_broadcast_snk_start_thread();

	return 0;
}
```

## src/audio_contexts.h
```c
/**
 * @file
 * @brief Bluetooth LE Audio context definitions
 *
 * Centralized context for advertising and PACS.
 *
 * Copyright (c) 2026 Demant A/S
 *
 * SPDX-License-Identifier: Apache-2.0
 */

#ifndef AUDIO_CONTEXTS_H__
#define AUDIO_CONTEXTS_H__

#include <zephyr/bluetooth/audio/audio.h>

/* Choose the contexts ONCE here — used for both sink and source */
#define MANDATORY_SINK_CONTEXT                                                 \
	(BT_AUDIO_CONTEXT_TYPE_UNSPECIFIED | BT_AUDIO_CONTEXT_TYPE_CONVERSATIONAL)

#define AVAILABLE_SINK_CONTEXT MANDATORY_SINK_CONTEXT
#define AVAILABLE_SOURCE_CONTEXT MANDATORY_SINK_CONTEXT

#endif /* AUDIO_CONTEXTS_H__ */
```

## src/bap_unicast_sr.c
```c
/** @file
 *  @brief Bluetooth Basic Audio Profile (BAP) Unicast Server role.
 *
 *  Copyright (c) 2021-2023 Nordic Semiconductor ASA
 *  Copyright (c) 2022 Codecoup
 *
 *  SPDX-License-Identifier: Apache-2.0
 */
#include <errno.h>
#include <stddef.h>
#include <stdint.h>
#include <string.h>

#include <zephyr/bluetooth/addr.h>
#include <zephyr/bluetooth/audio/audio.h>
#include <zephyr/bluetooth/audio/bap.h>
#include <zephyr/bluetooth/audio/lc3.h>
#include <zephyr/bluetooth/audio/pacs.h>
#include <zephyr/bluetooth/bluetooth.h>
#include <zephyr/bluetooth/conn.h>
#include <zephyr/bluetooth/gap.h>
#include <zephyr/bluetooth/hci.h>
#include <zephyr/bluetooth/hci_types.h>
#include <zephyr/bluetooth/iso.h>
#include <zephyr/kernel.h>
#include <zephyr/net_buf.h>
#include <zephyr/sys/byteorder.h>
#include <zephyr/sys/printk.h>
#include <zephyr/sys/util.h>
#include <zephyr/sys/util_macro.h>

#include "hap_ha.h"

NET_BUF_POOL_FIXED_DEFINE(tx_pool, CONFIG_BT_ASCS_MAX_ASE_SRC_COUNT,
			  BT_ISO_SDU_BUF_SIZE(CONFIG_BT_ISO_TX_MTU),
			  CONFIG_BT_CONN_TX_USER_DATA_SIZE, NULL);

static const struct bt_audio_codec_cap lc3_codec_cap = BT_AUDIO_CODEC_CAP_LC3(
	BT_AUDIO_CODEC_CAP_FREQ_16KHZ | BT_AUDIO_CODEC_CAP_FREQ_24KHZ,
	BT_AUDIO_CODEC_CAP_DURATION_10, BT_AUDIO_CODEC_CAP_CHAN_COUNT_SUPPORT(1), 40u, 60u, 1u,
	HAP_CONTEXT);

static struct bt_conn *default_conn;
static struct k_work_delayable audio_send_work;
static struct bt_bap_stream streams[CONFIG_BT_ASCS_MAX_ASE_SNK_COUNT +
		    CONFIG_BT_ASCS_MAX_ASE_SRC_COUNT];
static struct audio_source {
	struct bt_bap_stream *stream;
	uint16_t seq_num;
} source_streams[CONFIG_BT_ASCS_MAX_ASE_SRC_COUNT];
static size_t configured_source_stream_count;

static const struct bt_bap_qos_cfg_pref qos_pref =
	BT_BAP_QOS_CFG_PREF(true, BT_GAP_LE_PHY_2M, 0x02, 10, 20000, 40000, 20000, 40000);


static uint16_t get_and_incr_seq_num(const struct bt_bap_stream *stream)
{
	for (size_t i = 0U; i < configured_source_stream_count; i++) {
		if (stream == source_streams[i].stream) {
			return source_streams[i].seq_num++;
		}
	}

	printk("Could not find endpoint from stream %p\n", stream);

	return 0;
}

static void print_hex(const uint8_t *ptr, size_t len)
{
	while (len-- != 0) {
		printk("%02x", *ptr++);
	}
}

static bool print_cb(struct bt_data *data, void *user_data)
{
	const char *str = (const char *)user_data;

	printk("%s: type 0x%02x value_len %u\n", str, data->type, data->data_len);
	print_hex(data->data, data->data_len);
	printk("\n");

	return true;
}

static void print_codec_cfg(const struct bt_audio_codec_cfg *codec_cfg)
{
	printk("codec_cfg 0x%02x cid 0x%04x vid 0x%04x count %u\n", codec_cfg->id, codec_cfg->cid,
	       codec_cfg->vid, codec_cfg->data_len);

	if (codec_cfg->id == BT_HCI_CODING_FORMAT_LC3) {
		enum bt_audio_location chan_allocation;
		int ret;

		/* LC3 uses the generic LTV format - other codecs might do as well */

		bt_audio_data_parse(codec_cfg->data, codec_cfg->data_len, print_cb, "data");

		ret = bt_audio_codec_cfg_get_freq(codec_cfg);
		if (ret > 0) {
			printk("  Frequency: %d Hz\n", bt_audio_codec_cfg_freq_to_freq_hz(ret));
		}

		ret = bt_audio_codec_cfg_get_frame_dur(codec_cfg);
		if (ret > 0) {
			printk("  Frame Duration: %d us\n",
			       bt_audio_codec_cfg_frame_dur_to_frame_dur_us(ret));
		}

		ret = bt_audio_codec_cfg_get_chan_allocation(codec_cfg, &chan_allocation, false);
		if (ret == 0) {
			printk("  Channel allocation: 0x%x\n", chan_allocation);
		}

		printk("  Octets per frame: %d (negative means value not pressent)\n",
		       bt_audio_codec_cfg_get_octets_per_frame(codec_cfg));
		printk("  Frames per SDU: %d\n",
		       bt_audio_codec_cfg_get_frame_blocks_per_sdu(codec_cfg, true));
	} else {
		print_hex(codec_cfg->data, codec_cfg->data_len);
	}

	bt_audio_data_parse(codec_cfg->meta, codec_cfg->meta_len, print_cb, "meta");
}

static void print_qos(const struct bt_bap_qos_cfg *qos)
{
	printk("QoS: interval %u framing 0x%02x phy 0x%02x sdu %u "
	       "rtn %u latency %u pd %u\n",
	       qos->interval, qos->framing, qos->phy, qos->sdu, qos->rtn, qos->latency, qos->pd);
}

/**
 * @brief Send audio data on timeout
 *
 * This will send an increasing amount of audio data, starting from 1 octet.
 * The data is just mock data, and does not actually represent any audio.
 *
 * First iteration : 0x00
 * Second iteration: 0x00 0x01
 * Third iteration : 0x00 0x01 0x02
 *
 * And so on, until it wraps around the configured MTU (CONFIG_BT_ISO_TX_MTU)
 *
 * @param work Pointer to the work structure
 */
static void audio_timer_timeout(struct k_work *work)
{
	int ret;
	static uint8_t buf_data[CONFIG_BT_ISO_TX_MTU];
	static bool data_initialized;
	struct net_buf *buf;
	static size_t len_to_send = 1;

	if (!data_initialized) {
		/* TODO: Actually encode some audio data */
		for (size_t i = 0U; i < ARRAY_SIZE(buf_data); i++) {
			buf_data[i] = (uint8_t)i;
		}

		data_initialized = true;
	}

	/* We configured the sink streams to be first in `streams`, so that
	 * we can use `stream[i]` to select sink streams (i.e. streams with
	 * data going to the server)
	 */
	for (size_t i = 0; i < configured_source_stream_count; i++) {
		struct bt_bap_stream *stream = source_streams[i].stream;

		buf = net_buf_alloc(&tx_pool, K_NO_WAIT);
		if (buf == NULL) {
			printk("Failed to allocate TX buffer\n");
			/* Break and retry later */
			break;
		}
		net_buf_reserve(buf, BT_ISO_CHAN_SEND_RESERVE);

		net_buf_add_mem(buf, buf_data, len_to_send);

		ret = bt_bap_stream_send(stream, buf, get_and_incr_seq_num(stream));
		if (ret < 0) {
			printk("Failed to send audio data on streams[%zu] (%p): (%d)\n", i, stream,
			       ret);
			net_buf_unref(buf);
		} else {
			printk("Sending mock data with len %zu on streams[%zu] (%p)\n", len_to_send,
			       i, stream);
		}
	}

	k_work_schedule(&audio_send_work, K_MSEC(1000U));

	len_to_send++;
	if (len_to_send > ARRAY_SIZE(buf_data)) {
		len_to_send = 1;
	}
}

static struct bt_bap_stream *stream_alloc(void)
{
	for (size_t i = 0; i < ARRAY_SIZE(streams); i++) {
		struct bt_bap_stream *stream = &streams[i];

		if (!stream->conn) {
			return stream;
		}
	}

	return NULL;
}

static int lc3_config(struct bt_conn *conn, const struct bt_bap_ep *ep, enum bt_audio_dir dir,
		      const struct bt_audio_codec_cfg *codec_cfg, struct bt_bap_stream **stream,
		      struct bt_bap_qos_cfg_pref *const pref, struct bt_bap_ascs_rsp *rsp)
{
	printk("ASE Codec Config: conn %p ep %p dir %u\n", conn, ep, dir);

	print_codec_cfg(codec_cfg);

	*stream = stream_alloc();
	if (*stream == NULL) {
		printk("No streams available\n");
		*rsp = BT_BAP_ASCS_RSP(BT_BAP_ASCS_RSP_CODE_NO_MEM, BT_BAP_ASCS_REASON_NONE);
		return -ENOMEM;
	}

	printk("ASE Codec Config stream %p\n", *stream);

	if (dir == BT_AUDIO_DIR_SOURCE) {
		source_streams[configured_source_stream_count++].stream = *stream;
	}

	*pref = qos_pref;

	return 0;
}

static int lc3_reconfig(struct bt_bap_stream *stream, enum bt_audio_dir dir,
			const struct bt_audio_codec_cfg *codec_cfg,
			struct bt_bap_qos_cfg_pref *const pref, struct bt_bap_ascs_rsp *rsp)
{
	printk("ASE Codec Reconfig: stream %p\n", stream);

	print_codec_cfg(codec_cfg);

	*rsp = BT_BAP_ASCS_RSP(BT_BAP_ASCS_RSP_CODE_CONF_UNSUPPORTED, BT_BAP_ASCS_REASON_NONE);

	/* We only support one QoS at the moment, reject changes */
	return -ENOEXEC;
}

static int lc3_qos(struct bt_bap_stream *stream, const struct bt_bap_qos_cfg *qos,
		   struct bt_bap_ascs_rsp *rsp)
{
	printk("QoS: stream %p qos %p\n", stream, qos);

	print_qos(qos);

	return 0;
}

static int lc3_enable(struct bt_bap_stream *stream, const uint8_t meta[], size_t meta_len,
		      struct bt_bap_ascs_rsp *rsp)
{
	printk("Enable: stream %p meta_len %zu\n", stream, meta_len);

	return 0;
}

static int lc3_start(struct bt_bap_stream *stream, struct bt_bap_ascs_rsp *rsp)
{
	printk("Start: stream %p\n", stream);

	if (IS_ENABLED(CONFIG_BT_ASCS_ASE_SRC)) {
		for (size_t i = 0U; i < configured_source_stream_count; i++) {
			if (source_streams[i].stream == stream) {
				source_streams[i].seq_num = 0U;
				break;
			}
		}

		if (configured_source_stream_count > 0 &&
		    !k_work_delayable_is_pending(&audio_send_work)) {

			/* Start send timer */
			k_work_schedule(&audio_send_work, K_MSEC(0));
		}
	}

	return 0;
}

static bool data_func_cb(struct bt_data *data, void *user_data)
{
	struct bt_bap_ascs_rsp *rsp = (struct bt_bap_ascs_rsp *)user_data;

	if (!BT_AUDIO_METADATA_TYPE_IS_KNOWN(data->type)) {
		printk("Invalid metadata type %u or length %u\n", data->type, data->data_len);
		*rsp = BT_BAP_ASCS_RSP(BT_BAP_ASCS_RSP_CODE_METADATA_REJECTED, data->type);

		return -EINVAL;
	}

	return true;
}

static int lc3_metadata(struct bt_bap_stream *stream, const uint8_t meta[], size_t meta_len,
			struct bt_bap_ascs_rsp *rsp)
{
	printk("Metadata: stream %p meta_len %zu\n", stream, meta_len);

	return bt_audio_data_parse(meta, meta_len, data_func_cb, rsp);
}

static int lc3_disable(struct bt_bap_stream *stream, struct bt_bap_ascs_rsp *rsp)
{
	printk("Disable: stream %p\n", stream);

	return 0;
}

static int lc3_stop(struct bt_bap_stream *stream, struct bt_bap_ascs_rsp *rsp)
{
	printk("Stop: stream %p\n", stream);

	return 0;
}

static int lc3_release(struct bt_bap_stream *stream, struct bt_bap_ascs_rsp *rsp)
{
	printk("Release: stream %p\n", stream);
	return 0;
}

static struct bt_bap_unicast_server_register_param param = {CONFIG_BT_ASCS_MAX_ASE_SNK_COUNT,
							    CONFIG_BT_ASCS_MAX_ASE_SRC_COUNT};

static const struct bt_bap_unicast_server_cb unicast_server_cb = {
	.config = lc3_config,
	.reconfig = lc3_reconfig,
	.qos = lc3_qos,
	.enable = lc3_enable,
	.start = lc3_start,
	.metadata = lc3_metadata,
	.disable = lc3_disable,
	.stop = lc3_stop,
	.release = lc3_release,
};

static void stream_recv(struct bt_bap_stream *stream, const struct bt_iso_recv_info *info,
			struct net_buf *buf)
{
	printk("Incoming audio on stream %p len %u\n", stream, buf->len);
}

static void stream_enabled_cb(struct bt_bap_stream *stream)
{
	/* The unicast server is responsible for starting sink ASEs after the
	 * client has enabled them.
	 */
	int err;
	struct bt_bap_ep_info info;

	err = bt_bap_ep_get_info(stream->ep, &info);
	__ASSERT(err == 0, "bt_bap_ep_get_info() failed (err %d)", err);

	if (info.dir == BT_AUDIO_DIR_SINK) {
		err = bt_bap_stream_start(stream);
		if (err != 0) {
			printk("Failed to start stream %p: %d\n", stream, err);
		}
	}
}

static struct bt_bap_stream_ops stream_ops = {
	.recv = stream_recv,
	.enabled = stream_enabled_cb,
};

static void connected(struct bt_conn *conn, uint8_t err)
{
	char addr[BT_ADDR_LE_STR_LEN];

	bt_addr_le_to_str(bt_conn_get_dst(conn), addr, sizeof(addr));

	if (err != 0) {
		printk("Failed to connect to %s %u %s\n", addr, err, bt_hci_err_to_str(err));

		default_conn = NULL;
		return;
	}

	printk("Connected: %s\n", addr);
	default_conn = bt_conn_ref(conn);
}

static void disconnected(struct bt_conn *conn, uint8_t reason)
{
	char addr[BT_ADDR_LE_STR_LEN];
	struct k_work_sync sync;

	if (conn != default_conn) {
		return;
	}

	bt_addr_le_to_str(bt_conn_get_dst(conn), addr, sizeof(addr));

	printk("Disconnected: %s, reason 0x%02x %s\n", addr, reason, bt_hci_err_to_str(reason));

	bt_conn_unref(default_conn);
	default_conn = NULL;

	if (IS_ENABLED(CONFIG_BT_ASCS_ASE_SRC)) {
		/* reset data */
		(void)memset(source_streams, 0, sizeof(source_streams));
		configured_source_stream_count = 0U;
		k_work_cancel_delayable_sync(&audio_send_work, &sync);
	}
}

BT_CONN_CB_DEFINE(conn_callbacks) = {
	.connected = connected,
	.disconnected = disconnected,
};

static struct bt_pacs_cap cap_sink = {
	.codec_cap = &lc3_codec_cap,
};

static struct bt_pacs_cap cap_source = {
	.codec_cap = &lc3_codec_cap,
};

static int set_location(void)
{
	int err;

	/* HAP_d1.0 §3.7 (BAP Unicast Server role)
	 * A Banded Hearing Aid in the HA role shall set the Front Left and
	 * Front Right bits to 1 in the Audio Locations characteristic value.
	 * For LEFT/RIGHT devices, set the appropriate single channel.
	 */
	if (IS_ENABLED(CONFIG_HAP_HA_HEARING_AID_BANDED)) {
		/* BANDED: set both L+R */
		if (IS_ENABLED(CONFIG_BT_PAC_SRC_LOC)) {
			err = bt_pacs_set_location(BT_AUDIO_DIR_SOURCE,
						   BT_AUDIO_LOCATION_FRONT_LEFT |
							   BT_AUDIO_LOCATION_FRONT_RIGHT);
			if (err != 0) {
				printk("Failed to set source location (BANDED) (err %d)\n", err);
				return err;
			}
		}

		if (IS_ENABLED(CONFIG_BT_PAC_SNK_LOC)) {
			err = bt_pacs_set_location(BT_AUDIO_DIR_SINK,
						   BT_AUDIO_LOCATION_FRONT_LEFT |
							   BT_AUDIO_LOCATION_FRONT_RIGHT);
			if (err != 0) {
				printk("Failed to set sink location (BANDED) (err %d)\n", err);
				return err;
			}
		}
	} else if (IS_ENABLED(CONFIG_HAP_HA_HEARING_AID_LEFT)) {
		/* LEFT: set FL for both dirs (if enabled) */
		if (IS_ENABLED(CONFIG_BT_PAC_SRC_LOC)) {
			err = bt_pacs_set_location(BT_AUDIO_DIR_SOURCE,
						   BT_AUDIO_LOCATION_FRONT_LEFT);
			if (err != 0) {
				printk("Failed to set source location (LEFT) (err %d)\n", err);
				return err;
			}
		}

		if (IS_ENABLED(CONFIG_BT_PAC_SNK_LOC)) {
			err = bt_pacs_set_location(BT_AUDIO_DIR_SINK, BT_AUDIO_LOCATION_FRONT_LEFT);
			if (err != 0) {
				printk("Failed to set sink location (LEFT) (err %d)\n", err);
				return err;
			}
		}

	} else {
		/* RIGHT (default): set FR for both dirs (if enabled) */
		if (IS_ENABLED(CONFIG_BT_PAC_SRC_LOC)) {
			err = bt_pacs_set_location(BT_AUDIO_DIR_SOURCE,
						   BT_AUDIO_LOCATION_FRONT_RIGHT);
			if (err != 0) {
				printk("Failed to set source location (RIGHT) (err %d)\n", err);
				return err;
			}
		}

		if (IS_ENABLED(CONFIG_BT_PAC_SNK_LOC)) {
			err = bt_pacs_set_location(BT_AUDIO_DIR_SINK,
						   BT_AUDIO_LOCATION_FRONT_RIGHT);
			if (err != 0) {
				printk("Failed to set sink location (RIGHT) (err %d)\n", err);
				return err;
			}
		}
	}

	printk("Location successfully set\n");
	return 0;
}

static int set_contexts(void)
{
	int err;

	if (IS_ENABLED(CONFIG_BT_PAC_SNK)) {
		err = bt_pacs_set_supported_contexts(BT_AUDIO_DIR_SINK, HAP_CONTEXT);
		if (err != 0) {
			printk("Failed to set sink supported contexts (err %d)\n", err);
			return err;
		}

		err = bt_pacs_set_available_contexts(BT_AUDIO_DIR_SINK, HAP_CONTEXT);
		if (err != 0) {
			printk("Failed to set sink available contexts (err %d)\n", err);
			return err;
		}
	}

	if (IS_ENABLED(CONFIG_BT_PAC_SRC)) {
		err = bt_pacs_set_supported_contexts(BT_AUDIO_DIR_SOURCE, HAP_CONTEXT);
		if (err != 0) {
			printk("Failed to set source supported contexts (err %d)\n", err);
			return err;
		}

		err = bt_pacs_set_available_contexts(BT_AUDIO_DIR_SOURCE, HAP_CONTEXT);
		if (err != 0) {
			printk("Failed to set source available contexts (err %d)\n", err);
			return err;
		}
	}

	printk("Supported & available contexts successfully set\n");
	return 0;
}

int bap_unicast_sr_init(void)
{
	const struct bt_pacs_register_param pacs_param = {
		.snk_pac = true,
		.snk_loc = true,
		.src_pac = true,
		.src_loc = true,
	};
	int err;

	err = bt_pacs_register(&pacs_param);
	if (err) {
		printk("Could not register PACS (err %d)\n", err);
		return err;
	}

	bt_bap_unicast_server_register(&param);
	bt_bap_unicast_server_register_cb(&unicast_server_cb);

	bt_pacs_cap_register(BT_AUDIO_DIR_SINK, &cap_sink);

	if (IS_ENABLED(CONFIG_BT_ASCS_ASE_SRC)) {
		bt_pacs_cap_register(BT_AUDIO_DIR_SOURCE, &cap_source);
	}

	for (size_t i = 0; i < ARRAY_SIZE(streams); i++) {
		bt_bap_stream_cb_register(&streams[i], &stream_ops);
	}

	err = set_location();
	if (err != 0) {
		return err;
	}

	err = set_contexts();
	if (err != 0) {
		return err;
	}

	if (IS_ENABLED(CONFIG_BT_ASCS_ASE_SRC)) {
		k_work_init_delayable(&audio_send_work, audio_timer_timeout);
	}

	return 0;
}
```

## src/hap_ha.h
```c
/*
 * Copyright (c) 2022 Codecoup
 *
 * SPDX-License-Identifier: Apache-2.0
 */

#include <stdint.h>
#include <zephyr/bluetooth/audio/audio.h>

/* Choose the contexts ONCE here — used for both sink and source */
#define HAP_CONTEXT                                                                                \
	(BT_AUDIO_CONTEXT_TYPE_UNSPECIFIED | BT_AUDIO_CONTEXT_TYPE_CONVERSATIONAL |                \
	 BT_AUDIO_CONTEXT_TYPE_MEDIA)

/**
 * @brief Initialize the BAP Unicast Server role
 *
 * @return 0 if success, errno on failure.
 */
int bap_unicast_sr_init(void);

/**
 * @brief Initialize the CSIP Set Member role
 *
 * @return 0 if success, errno on failure.
 */
int csip_set_member_init(void);

/**
 * @brief Generate the Resolvable Set Identifier (RSI) value.
 *
 * @param rsi Pointer to place the 6-octet newly generated RSI data.
 *
 * @return 0 if on success, errno on error.
 */
int csip_generate_rsi(uint8_t *rsi);

/**
 * @brief Initialize the VCP Volume Renderer role
 *
 * @return 0 if success, errno on failure.
 */
int vcp_vol_renderer_init(void);

/**
 * @brief Initialize the MICP Microphone Device role
 *
 * @return 0 if success, errno on failure.
 */
int micp_mic_dev_init(void);

/**
 * @brief Initialize the CCP Call Control Client role
 *
 * @return 0 if success, errno on failure.
 */
int ccp_call_ctrl_init(void);

/**
 * @brief Initialize the HAS Server
 *
 * This will register hearing aid sample presets.
 *
 * @return 0 if success, errno on failure.
 */
int has_server_init(void);

/**
 * @brief Initialize the Broadcast Sink role
 *
 * @return 0 if success, errno on failure.
 */
int bap_broadcast_snk_init(void);

/**
 * @brief Initialize the Broadcast Sink thread
 */
void bap_broadcast_snk_start_thread(void);
```

## src/lc3.c
```c
/**
 * @file
 * @brief Bluetooth BAP Broadcast Sink LC3 extension
 *
 * This files handles all the LC3 related functionality for the sample
 *
 * Copyright (c) 2025 Nordic Semiconductor ASA
 *
 * SPDX-License-Identifier: Apache-2.0
 */

#include <errno.h>
#include <stdbool.h>
#include <stddef.h>
#include <stdint.h>
#include <string.h>

#include <zephyr/autoconf.h>
#include <zephyr/bluetooth/audio/audio.h>
#include <zephyr/bluetooth/hci_types.h>
#include <zephyr/bluetooth/iso.h>
#include <zephyr/device.h>
#include <zephyr/devicetree.h>
#include <zephyr/kernel.h>
#include <zephyr/logging/log.h>
#include <zephyr/logging/log_core.h>
#include <zephyr/net_buf.h>
#include <zephyr/shell/shell.h>
#include <zephyr/sys/ring_buffer.h>
#include <zephyr/sys/util.h>
#include <zephyr/sys/util_macro.h>
#include <zephyr/sys_clock.h>
#include <zephyr/toolchain.h>
#include <zephyr/usb/usb_device.h>
#include <zephyr/usb/class/usb_audio.h>

#include "lc3.h"
#include "stream_rx.h"
#include "usb.h"

LOG_MODULE_REGISTER(lc3, CONFIG_LOG_DEFAULT_LEVEL);

#define LC3_ENCODER_STACK_SIZE 4096
#define LC3_ENCODER_PRIORITY   5

struct lc3_data {
	void *fifo_reserved; /* 1st word reserved for use by FIFO */
	struct net_buf *buf;
	struct stream_rx *stream;
	uint32_t ts;
	bool do_plc;
};

K_MEM_SLAB_DEFINE_STATIC(lc3_data_slab, sizeof(struct lc3_data), CONFIG_BT_ISO_RX_BUF_COUNT,
			 __alignof__(struct lc3_data));

static int16_t lc3_rx_buf[LC3_MAX_NUM_SAMPLES_MONO];
static K_FIFO_DEFINE(lc3_in_fifo);

/* We only want to send USB to left/right from a single stream. If we have 2 left streams, the
 * outgoing audio is going to be terrible.
 * Since a stream can contain stereo data, both of these may be the same stream.
 */
static struct stream_rx *usb_left_stream;
static struct stream_rx *usb_right_stream;

static int init_lc3_decoder(struct stream_rx *stream, uint32_t lc3_frame_duration_us,
			    uint32_t lc3_freq_hz)
{
	if (stream == NULL) {
		LOG_ERR("NULL stream to init LC3 decoder");
		return -EINVAL;
	}

	if (stream->lc3_decoder != NULL) {
		LOG_ERR("Already initialized");
		return -EALREADY;
	}

	if (lc3_freq_hz == 0U || lc3_frame_duration_us == 0U) {
		LOG_ERR("Invalid freq (%u) or frame duration (%u)", lc3_freq_hz,
			lc3_frame_duration_us);

		return -EINVAL;
	}

	LOG_INF("Initializing the LC3 decoder with %u us duration and %u Hz frequency",
		lc3_frame_duration_us, lc3_freq_hz);
	/* Create the decoder instance. This shall complete before stream_started() is called. */
	stream->lc3_decoder =
		lc3_setup_decoder(lc3_frame_duration_us, lc3_freq_hz,
				  IS_ENABLED(CONFIG_USE_USB_AUDIO_OUTPUT) ? USB_SAMPLE_RATE_HZ : 0,
				  &stream->lc3_decoder_mem);
	if (stream->lc3_decoder == NULL) {
		LOG_ERR("Failed to setup LC3 decoder - wrong parameters?\n");
		return -EINVAL;
	}

	LOG_INF("Initialized LC3 decoder for %p", stream);

	return 0;
}

static bool decode_frame(struct lc3_data *data, size_t frame_cnt)
{
	const struct stream_rx *stream = data->stream;
	const size_t total_frames = stream->lc3_chan_cnt * stream->lc3_frame_blocks_per_sdu;
	const uint16_t octets_per_frame = stream->lc3_octets_per_frame;
	struct net_buf *buf = data->buf;
	void *iso_data;
	int err;


	if (data->do_plc) {
		iso_data = NULL; /* perform PLC */

#if CONFIG_INFO_REPORTING_INTERVAL > 0
		if ((stream->reporting_info.lc3_decoded_cnt % CONFIG_INFO_REPORTING_INTERVAL) ==
		    0) {
			LOG_DBG("[%zu]: Performing PLC", stream->reporting_info.lc3_decoded_cnt);
		}
#endif /* CONFIG_INFO_REPORTING_INTERVAL > 0 */

		data->do_plc = false; /* clear flag */
	} else {
		iso_data = net_buf_pull_mem(data->buf, octets_per_frame);

#if CONFIG_INFO_REPORTING_INTERVAL > 0
		if ((stream->reporting_info.lc3_decoded_cnt % CONFIG_INFO_REPORTING_INTERVAL) ==
		    0) {
			LOG_DBG("[%zu]: Decoding frame of size %u (%u/%u)",
				stream->reporting_info.lc3_decoded_cnt, octets_per_frame,
				frame_cnt + 1, total_frames);
		}
#endif /* CONFIG_INFO_REPORTING_INTERVAL > 0 */
	}

	err = lc3_decode(stream->lc3_decoder, iso_data, octets_per_frame, LC3_PCM_FORMAT_S16,
			 lc3_rx_buf, 1);
	if (err < 0) {
		LOG_ERR("Failed to decode LC3 data (%u/%u - %u/%u)", frame_cnt + 1, total_frames,
			octets_per_frame * frame_cnt, buf->len);
		return false;
	}

	return true;
}

static int get_lc3_chan_alloc_from_index(const struct stream_rx *stream, uint8_t index,
					 enum bt_audio_location *chan_alloc)
{
#if defined(CONFIG_USE_USB_AUDIO_OUTPUT)
	const bool has_left = (stream->lc3_chan_allocation & BT_AUDIO_LOCATION_FRONT_LEFT) != 0;
	const bool has_right = (stream->lc3_chan_allocation & BT_AUDIO_LOCATION_FRONT_RIGHT) != 0;
	const bool is_mono = stream->lc3_chan_allocation == BT_AUDIO_LOCATION_MONO_AUDIO;
	const bool is_left = index == 0 && has_left;
	const bool is_right = has_right && (index == 0U || (index == 1U && has_left));

	/* LC3 is always Left before Right, so we can use the index and the stream channel
	 * allocation to determine if index 0 is left or right.
	 */
	if (is_left) {
		*chan_alloc = BT_AUDIO_LOCATION_FRONT_LEFT;
	} else if (is_right) {
		*chan_alloc = BT_AUDIO_LOCATION_FRONT_RIGHT;
	} else if (is_mono) {
		*chan_alloc = BT_AUDIO_LOCATION_MONO_AUDIO;
	} else {
		/* Not suitable for USB */
		return -EINVAL;
	}

	return 0;
#else  /* !CONFIG_USE_USB_AUDIO_OUTPUT */
	return -EINVAL;
#endif /* CONFIG_USE_USB_AUDIO_OUTPUT */
}

static size_t decode_frame_block(struct lc3_data *data, size_t frame_cnt)
{
	const struct stream_rx *stream = data->stream;
	const uint8_t chan_cnt = stream->lc3_chan_cnt;
	size_t decoded_frames = 0U;

	for (uint8_t i = 0U; i < chan_cnt; i++) {
		/* We provide the total number of decoded frames to `decode_frame` for logging
		 * purposes
		 */
		if (decode_frame(data, frame_cnt + decoded_frames)) {
			decoded_frames++;

			if (IS_ENABLED(CONFIG_USE_USB_AUDIO_OUTPUT)) {
				enum bt_audio_location chan_alloc;
				int err;

				err = get_lc3_chan_alloc_from_index(stream, i, &chan_alloc);
				if (err != 0) {
					/* Not suitable for USB */
					continue;
				}

				/* We only want to left or right from one stream to USB */
				if ((chan_alloc == BT_AUDIO_LOCATION_FRONT_LEFT &&
				     stream != usb_left_stream) ||
				    (chan_alloc == BT_AUDIO_LOCATION_FRONT_RIGHT &&
				     stream != usb_right_stream)) {
					continue;
				}

				/* TODO: Add support for properly support the presentation delay.
				 * For now we just send audio to USB as soon as we get it
				 */
				err = usb_add_frame_to_usb(chan_alloc, lc3_rx_buf,
							   sizeof(lc3_rx_buf), data->ts);
				if (err == -EINVAL) {
					continue;
				}
			}
		} else {
			/* If decoding failed, we clear the data to USB as it would contain
			 * invalid data
			 */
			if (IS_ENABLED(CONFIG_USE_USB_AUDIO_OUTPUT)) {
				usb_clear_frames_to_usb();
			}

			break;
		}
	}

	return decoded_frames;
}

static void do_lc3_decode(struct lc3_data *data)
{
	struct stream_rx *stream = data->stream;

	if (stream->lc3_decoder != NULL) {
		const uint8_t frame_blocks_per_sdu = stream->lc3_frame_blocks_per_sdu;
		size_t frame_cnt;

		frame_cnt = 0;
		for (uint8_t i = 0U; i < frame_blocks_per_sdu; i++) {
			const size_t decoded_frames = decode_frame_block(data, frame_cnt);

			if (decoded_frames == 0) {
				break;
			}

			frame_cnt += decoded_frames;
		}

#if CONFIG_INFO_REPORTING_INTERVAL > 0
		stream->reporting_info.lc3_decoded_cnt++;
#endif /* CONFIG_INFO_REPORTING_INTERVAL > 0 */
	}

	net_buf_unref(data->buf);
}

static void lc3_decoder_thread_func(void *arg1, void *arg2, void *arg3)
{
	while (true) {
		struct lc3_data *data = k_fifo_get(&lc3_in_fifo, K_FOREVER);
		struct stream_rx *stream = data->stream;

		if (stream->lc3_decoder == NULL) {
			LOG_WRN("Decoder is NULL, discarding data from FIFO");
			k_mem_slab_free(&lc3_data_slab, (void *)data);
			continue; /* Wait for new data */
		}

		do_lc3_decode(data);

		k_mem_slab_free(&lc3_data_slab, (void *)data);
	}
}

int lc3_enable(struct stream_rx *stream)
{
	const struct bt_audio_codec_cfg *codec_cfg = stream->stream.codec_cfg;
	uint32_t lc3_frame_duration_us;
	uint32_t lc3_freq_hz;
	int ret;

	if (codec_cfg->id != BT_HCI_CODING_FORMAT_LC3) {
		return -EINVAL;
	}

	ret = bt_audio_codec_cfg_get_freq(codec_cfg);
	if (ret >= 0) {
		ret = bt_audio_codec_cfg_freq_to_freq_hz(ret);

		if (ret > 0) {
			if (ret == 8000 || ret == 16000 || ret == 24000 || ret == 32000 ||
			    ret == 48000) {
				lc3_freq_hz = (uint32_t)ret;
			} else {
				LOG_ERR("Unsupported frequency for LC3: %d", ret);
				lc3_freq_hz = 0U;
			}
		} else {
			LOG_ERR("Invalid frequency: %d", ret);
			lc3_freq_hz = 0U;
		}
	} else {
		LOG_ERR("Could not get frequency: %d", ret);
		lc3_freq_hz = 0U;
	}

	if (lc3_freq_hz == 0U) {
		return -EINVAL;
	}

	ret = bt_audio_codec_cfg_get_frame_dur(codec_cfg);
	if (ret >= 0) {
		ret = bt_audio_codec_cfg_frame_dur_to_frame_dur_us(ret);
		if (ret > 0) {
			lc3_frame_duration_us = (uint32_t)ret;
		} else {
			LOG_ERR("Invalid frame duration: %d", ret);
			lc3_frame_duration_us = 0U;
		}
	} else {
		LOG_ERR("Could not get frame duration: %d", ret);
		lc3_frame_duration_us = 0U;
	}

	if (lc3_frame_duration_us == 0U) {
		return -EINVAL;
	}

	ret = bt_audio_codec_cfg_get_chan_allocation(codec_cfg, &stream->lc3_chan_allocation, true);
	if (ret == 0) {
		stream->lc3_chan_cnt = bt_audio_get_chan_count(stream->lc3_chan_allocation);
	} else {
		LOG_DBG("Could not get channel allocation: %d", ret);
		stream->lc3_chan_cnt = 0U;
	}

	if (stream->lc3_chan_cnt == 0U) {
		return -EINVAL;
	}

	ret = bt_audio_codec_cfg_get_frame_blocks_per_sdu(codec_cfg, true);
	if (ret >= 0) {
		stream->lc3_frame_blocks_per_sdu = (uint8_t)ret;
	} else {
		LOG_ERR("Could not get frame blocks per SDU: %d", ret);
		stream->lc3_frame_blocks_per_sdu = 0U;
	}

	if (stream->lc3_frame_blocks_per_sdu == 0U) {
		return -EINVAL;
	}

	ret = bt_audio_codec_cfg_get_octets_per_frame(codec_cfg);
	if (ret >= 0) {
		stream->lc3_octets_per_frame = (uint16_t)ret;
	} else {
		LOG_ERR("Could not get octets per frame: %d", ret);
		stream->lc3_octets_per_frame = 0U;
	}

	if (stream->lc3_octets_per_frame == 0U) {
		return -EINVAL;
	}

	if (stream->lc3_decoder == NULL) {
		const int err = init_lc3_decoder(stream, lc3_frame_duration_us, lc3_freq_hz);

		if (err != 0) {
			LOG_ERR("Failed to init LC3 decoder: %d", err);

			return err;
		}
	}

	if (IS_ENABLED(CONFIG_USE_USB_AUDIO_OUTPUT)) {
		if ((stream->lc3_chan_allocation & BT_AUDIO_LOCATION_FRONT_LEFT) != 0) {
			if (usb_left_stream == NULL) {
				LOG_INF("Setting USB left stream to %p", stream);
				usb_left_stream = stream;
			} else {
				LOG_WRN("Multiple left streams started");
			}
		}

		if ((stream->lc3_chan_allocation & BT_AUDIO_LOCATION_FRONT_RIGHT) != 0) {
			if (usb_right_stream == NULL) {
				LOG_INF("Setting USB right stream to %p", stream);
				usb_right_stream = stream;
			} else {
				LOG_WRN("Multiple right streams started");
			}
		}
	}

	return 0;
}

int lc3_disable(struct stream_rx *stream)
{
	if (stream->lc3_decoder == NULL) {
		return -EINVAL;
	}

	stream->lc3_decoder = NULL;

	if (IS_ENABLED(CONFIG_USE_USB_AUDIO_OUTPUT)) {
		if (usb_left_stream == stream) {
			usb_left_stream = NULL;
		}
		if (usb_right_stream == stream) {
			usb_right_stream = NULL;
		}
	}

	return 0;
}

void lc3_enqueue_for_decoding(struct stream_rx *stream, const struct bt_iso_recv_info *info,
			      struct net_buf *buf)
{
	const uint8_t frame_blocks_per_sdu = stream->lc3_frame_blocks_per_sdu;
	const uint16_t octets_per_frame = stream->lc3_octets_per_frame;
	const uint8_t chan_cnt = stream->lc3_chan_cnt;
	struct lc3_data *data;

	if (stream->lc3_decoder == NULL) {
		return;
	}

	/* Allocate a context that holds both the buffer and the stream so that we can
	 * send both of these values to the LC3 decoder thread as a single struct
	 * in a FIFO
	 */
	if (k_mem_slab_alloc(&lc3_data_slab, (void **)&data, K_NO_WAIT)) {
		LOG_WRN("Could not allocate LC3 data item");
		return;
	}

	if ((info->flags & BT_ISO_FLAGS_VALID) == 0) {
		data->do_plc = true;
	} else if (buf->len != (octets_per_frame * chan_cnt * frame_blocks_per_sdu)) {
		if (buf->len != 0U) {
			LOG_WRN("Expected %u frame blocks with %u channels of size %u, but "
				"length is %u",
				frame_blocks_per_sdu, chan_cnt, octets_per_frame, buf->len);
		}

		data->do_plc = true;
	}

	data->buf = net_buf_ref(buf);
	data->stream = stream;
	if (info->flags & BT_ISO_FLAGS_TS) {
		data->ts = info->ts;
	} else {
		data->ts = 0U;
	}

	k_fifo_put(&lc3_in_fifo, data);
}

int lc3_init(void)
{
	static K_KERNEL_STACK_DEFINE(lc3_decoder_thread_stack, 4096);
	const int lc3_decoder_thread_prio = K_PRIO_PREEMPT(5);
	static struct k_thread lc3_decoder_thread;
	static bool initialized;

	if (initialized) {
		return -EALREADY;
	}

	k_thread_create(&lc3_decoder_thread, lc3_decoder_thread_stack,
			K_KERNEL_STACK_SIZEOF(lc3_decoder_thread_stack), lc3_decoder_thread_func,
			NULL, NULL, NULL, lc3_decoder_thread_prio, 0, K_NO_WAIT);
	k_thread_name_set(&lc3_decoder_thread, "LC3 Decoder");

	LOG_INF("LC3 initialized");
	initialized = true;

	return 0;
}
```

## src/usb.h
```c
/**
 * @file
 * @brief Bluetooth BAP Broadcast Sink sample USB header
 *
 * This files handles all the USB related functionality for the sample
 *
 * Copyright (c) 2025 Nordic Semiconductor ASA
 *
 * SPDX-License-Identifier: Apache-2.0
 */

#ifndef SAMPLE_HAP_HA_USB_H
#define SAMPLE_HAP_HA_USB_H
#include <stdbool.h>
#include <stddef.h>
#include <stdint.h>
#include <string.h>

#include <zephyr/autoconf.h>
#include <zephyr/bluetooth/audio/audio.h>
#include <zephyr/device.h>
#include <zephyr/devicetree.h>
#include <zephyr/kernel.h>
#include <zephyr/logging/log.h>
#include <zephyr/net_buf.h>
#include <zephyr/shell/shell.h>
#include <zephyr/sys/ring_buffer.h>
#include <zephyr/sys/util.h>
#include <zephyr/sys/util_macro.h>
#include <zephyr/sys_clock.h>
#include <zephyr/toolchain.h>
#include <zephyr/usb/usb_device.h>
#include <zephyr/usb/class/usb_audio.h>

#define USB_SAMPLE_RATE_HZ 48000U

/**
 * @brief Add decoded frame to the USB buffer
 *
 * @param chan_allocation The channel of the frame (@ref BT_AUDIO_LOCATION_FRONT_LEFT, @ref
 *                        BT_AUDIO_LOCATION_FRONT_RIGHT or @ref BT_AUDIO_LOCATION_MONO_AUDIO)
 * @param frame The frame
 * @param frame_size The size of @p in octets
 * @param ts The timestamp of the frame
 *
 * @retval 0 Success
 * @retval -EINVAL Invalid channel, frame of framesize
 * @retval -ENOEXEC Old timestamp, discarded
 * @retval -ENOMEM No memory to enqueue
 */
int usb_add_frame_to_usb(enum bt_audio_location chan_allocation, const int16_t *frame,
			 size_t frame_size, uint32_t ts);

/**
 * @brief Clear last sent SDU
 *
 * If only part of the SDU could be decoded, this should be called
 */
void usb_clear_frames_to_usb(void);

/**
 * @brief Initialize the USB module
 *
 * This will start the USB thread if not already initialized
 *
 * @retval 0 Success
 * @retval -EALREADY Already initialized
 */
int usb_init(void);

#endif /* SAMPLE_HAP_HA_USB_H */
```
